## configs/cfbl_defconfig
```kconfig
CONFIG_MOTORS_ESC_PROTOCOL_DSHOT=y

CONFIG_ENABLE_THRUST_BAT_COMPENSATED=n

CONFIG_ESTIMATOR_AUTO_SELECT=y
CONFIG_CONTROLLER_AUTO_SELECT=y

CONFIG_MOTORS_REQUIRE_ARMING=y
CONFIG_MOTORS_DEFAULT_IDLE_THRUST=10000

CONFIG_DECK_RPM=y
CONFIG_DECK_FORCE="bcRpm"
```
